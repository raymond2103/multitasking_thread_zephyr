## CMakeLists.txt
```
# SPDX-License-Identifier: Apache-2.0

cmake_minimum_required(VERSION 3.20.0)
find_package(Zephyr REQUIRED HINTS $ENV{ZEPHYR_BASE})
project(multitasking_thread_zephyr)

target_sources(app PRIVATE 
src/main.c
src/THREAD_1/thread_1.c
src/THREAD_2/thread_2.c
)
```

## sample.yaml
```
sample:
  description: A simple application that demonstrates printing
  using thread on native posix
  name: multitasking_thread_zephyr
```

## prj.conf
```kconfig
CONFIG_STDOUT_CONSOLE=y
# enable to use thread names
CONFIG_THREAD_NAME=y
```

## src/main.c
```c
/**
 * @file main.c
 * @author Raymond Sebastian (raymondsebastian2112@gmail.com)
 * @brief 
 * @version 0.1
 * @date 2022-01-09
 * 
 * @copyright Copyright (c) 2022
 * 
 */
#include <zephyr.h>

#include "THREAD_1/thread_1.h"
#include "THREAD_2/thread_2.h"

#include "common.h"

void
main(void)
{
    /* Starting the threads in main */

    /* Starting thread 1 */
    start_thread_1();

    /* Starting thread 2 */
    start_thread_2();
}
```

## src/common.h
```c
/**
 * @file common.h
 * @author Raymond Sebastian (raymondsebastian2112@gmail.com)
 * @brief 
 * @version 0.1
 * @date 2022-01-09
 * 
 * @copyright Copyright (c) 2022
 * 
 */
#ifndef COMMON_H
#define COMMON_H

/**
 * Signal Buffer Struct, to be used by thread 1 to send.
 */
typedef struct {
    bool message_from_thread_1;

    /* Variable to send the timmer valuefor debbing */
    uint64_t timmer_count;
} signal_buffer_t;

#endif /* COMMON_H */
```

## src/default_config.h
```c
/**
 * @file default_config.h
 * @author Raymond Sebastian (raymondsebastian2112@gmail.com)
 * @brief 
 * @version 0.1
 * @date 2022-01-09
 * 
 * @copyright Copyright (c) 2022
 * 
 */
#ifndef DEFAULT_CONFIG_H
#define DEFAULT_CONFIG_H

/* Set this value to 1 for debugging the timmer count for the value being printed */
#define DEBUG_TIMMER                            0
#define DEBUG_TIME_DIFFERENCE                   0


/* delay (in sec) */
#define MIN_DELAY_PERIOD                        1
#define MAX_DELAY_PERIOD                        10
#define DELAY_INCREMENT_PERIOD                  1
#define DELAY_BETWEEN_EACH_THREAD_IN_SEC        1




#endif  /* DEFAULT_CONFIG_H */
```
